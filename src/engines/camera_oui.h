#ifndef CAMERA_OUI_H
#define CAMERA_OUI_H

#include <stdint.h>
#include <esp_attr.h>

static const char* const CAMERA_BRANDS[] = {
    "70mai", "Amcrest", "Arecont", "Arlo", "Avigilon", "Axis", "Blink", "CP Plus", "Canary",
    "Costar", "Dahua", "Digital Ally", "Digital Watchdog", "EZVIZ", "EarthCam", "FLIR", "GVI",
    "GeoVision", "Hanwha", "Hikvision", "IQinVision", "Imilab", "Jovision", "Lorex", "Lytx",
    "Mobotix", "Nest", "Night Owl", "Raysharp", "Reecam", "Reolink", "Rhombus", "Ring", "SkyBell",
    "Swann", "TKH Security", "Tattile", "Uniview", "Verkada", "Vicon", "Vivotek", "WatchGuard",
    "Wyze", "Y-cam", "Yi", "Zmodo",
};
static const int CAMERA_BRAND_COUNT = sizeof(CAMERA_BRANDS) / sizeof(CAMERA_BRANDS[0]);

static const uint32_t CAMERA_OUI_TABLE[] = {
    0x0000A524, 0x0002D128, 0x0003C519, 0x00047E23, 0x00066827, 0x00091812, 0x0013560F, 0x0013E211,
    0x001A0702, 0x001BD80F, 0x001D9629, 0x001ED123, 0x001F5417, 0x00203124, 0x0020B324, 0x0023631C,
    0x0023BD0B, 0x00407524, 0x00407F0F, 0x00408C05, 0x00408E24, 0x00501A14, 0x00604F24, 0x00651E01,
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    0xF8209707, 0xF84DFC13, 0xF8CE070A, 0xFC24220D, 0xFC5F490A, 0xFC9C9803, 0xFC9FFD13, 0xFCB69D0A,
};
static const int CAMERA_OUI_COUNT = sizeof(CAMERA_OUI_TABLE) / sizeof(CAMERA_OUI_TABLE[0]);

struct CameraBlock { uint8_t b[5]; uint8_t bits; uint8_t brand; };

static const CameraBlock CAMERA_BLOCK_TABLE[] = {
    { {0x00, 0x50, 0xC2, 0x1F, 0x20}, 36, 36 },
    { {0x00, 0x50, 0xC2, 0x26, 0x10}, 36, 36 },
    { {0x00, 0x50, 0xC2, 0x28, 0xE0}, 36, 36 },
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    { {0xDC, 0x4A, 0x9E, 0x60, 0x00}, 28, 36 },
};
static const int CAMERA_BLOCK_COUNT = sizeof(CAMERA_BLOCK_TABLE) / sizeof(CAMERA_BLOCK_TABLE[0]);

static inline int IRAM_ATTR cameraBrandForMac(const uint8_t* mac) {
    if (mac[0] & 0x03) return -1;
    for (int i = 0; i < CAMERA_BLOCK_COUNT; i++) {
        const CameraBlock& c = CAMERA_BLOCK_TABLE[i];
        if (mac[0] != c.b[0] || mac[1] != c.b[1] || mac[2] != c.b[2]) continue;
        bool hit = (c.bits == 28) ? ((mac[3] & 0xF0) == c.b[3])
                                  : (mac[3] == c.b[3] && (mac[4] & 0xF0) == c.b[4]);
        if (hit) return c.brand;
    }
    uint32_t key = ((uint32_t)mac[0] << 16) | ((uint32_t)mac[1] << 8) | mac[2];
    int lo = 0, hi = CAMERA_OUI_COUNT - 1;
    while (lo <= hi) {
        int mid = (lo + hi) >> 1;
        uint32_t oui = CAMERA_OUI_TABLE[mid] >> 8;
        if (oui == key) return (int)(CAMERA_OUI_TABLE[mid] & 0xFF);
        if (oui < key) lo = mid + 1; else hi = mid - 1;
    }
    return -1;
}

#endif
